## conf/distro/fptest.conf
```bitbake
# Distro Layer configuration
# include and overwrite default poky distro
include conf/distro/poky.conf
DISTRO = "fptest"
DISTRO_NAME = "FP-Linux"
DISTRO_VERSION = "1.0"
DISTRO_CODENAME = "Baervan Wildwanderer"
SDK_VENDOR = "-fptest-sdk"
SDK_VERSION="${DISTRO_VERSION}"
MAINTAINER = "fpersson.se@gmail.com"

TARGET_VENDOR = "-fptest"

# Override these in poky based distros
MYDISTRO_DEFAULT_DISTRO_FEATURES = "ext2 wifi systemd"
MYDISTRO_DEFAULT_EXTRA_RDEPENDS = "packagegroup-core-boot"
MYDISTRO_DEFAULT_EXTRA_RRECOMMENDS = "kernel-module-af-packet"

DISTRO_EXTRA_RDEPENDS += " ${MYDISTRO_DEFAULT_EXTRA_RDEPENDS}"
DISTRO_EXTRA_RRECOMMENDS += " ${MYDISTO_DEFAULT_EXTRA_RRECOMMENDS}"

DISTRO_FEATURES ?= "${MYDISTRO_DEFAULT_DISTRO_FEATURES} ${DISTRO_FEATURES_LIBC} "

PACKAGE_CLASSES = "package_ipk"
```

## conf/layer.conf
```bitbake
# We have a conf and classes directory, add to BBPATH
BBPATH .= ":${LAYERDIR}"

# We have recipes-* directories, add to BBFILES
BBFILES += "${LAYERDIR}/recipes-*/*/*.bb \
	${LAYERDIR}/recipes-*/*/*.bbappend"

BBFILE_COLLECTIONS += "meta-fptest"
BBFILE_PATTERN_meta-fptest = "^${LAYERDIR}/"
BBFILE_PRIORITY_meta-fptest = "6"
```
